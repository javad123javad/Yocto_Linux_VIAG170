## meta-bsp-thinclient/conf/layer.conf
```bitbake
# We have a conf and classes directory, add to BBPATH
BBPATH .= ":${LAYERDIR}"
MACHINE ??= "thinclient"
INITRAMFS_IMAGE = "core-image-base"

INITRAMFS_IMAGE_BUNDLE = "1"

IMAGE_FSTYPES = "cpio.gz tar.bz2"

# We have recipes-* directories, add to BBFILES
BBFILES += "${LAYERDIR}/recipes-*/*/*.bb \
            ${LAYERDIR}/recipes-*/*/*.bbappend"

BBFILE_COLLECTIONS += "meta-bsp-thinclient"
BBFILE_PATTERN_meta-bsp-thinclient = "^${LAYERDIR}/"
BBFILE_PRIORITY_meta-bsp-thinclient = "4"

LAYERDEPENDS_meta-bsp-thinclient = "core"
LAYERSERIES_COMPAT_meta-bsp-thinclient = "gatesgarth"
```
